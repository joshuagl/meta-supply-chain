## conf/layer.conf
```bitbake
# We have a conf and classes directory, add to BBPATH
BBPATH .= ":${LAYERDIR}"

# We have recipes-* directories, add to BBFILES
BBFILES += "${LAYERDIR}/recipes-*/*/*.bb \
            ${LAYERDIR}/recipes-*/*/*.bbappend"

BBFILE_COLLECTIONS += "meta-supply-chain"
BBFILE_PATTERN_meta-supply-chain = "^${LAYERDIR}/"
BBFILE_PRIORITY_meta-supply-chain = "8"

LAYERVERSION_meta-supply-chain = "1"
LAYERDEPENDS_meta-supply-chain = "core openembedded-layer meta-python"
LAYERSERIES_COMPAT_meta-supply-chain = "warrior"
```
